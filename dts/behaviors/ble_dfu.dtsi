/*
 * Copyright (c) 2026 zmk-feature-ble-dfu contributors
 * SPDX-License-Identifier: MIT
 */

/ {
    behaviors {
        ble_dfu: ble_dfu {
            compatible = "razily,behavior-ble-dfu";
            #binding-cells = <0>;
            display-name = "BLE DFU";
        };
    };
};

